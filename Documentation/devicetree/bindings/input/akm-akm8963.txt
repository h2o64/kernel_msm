## Documentation/devicetree/bindings/input/akm-akm8963.txt
```
AK8963C Magnetometer

AK8963C is a 3-axis electronic compass to measure earths geomagnetism
to determine azimuth.
It is connected to the host processor on the I2C interface.

Required properties:
- compatible:		Must be "motorola_compass,akm8963"
- reg:			Specifies the I2C address of the part.
- interrupt-parent:	The parent interrupt controller
- interrupts:		Interrupt line connected to the main SoC
- akm8963,gpio_DRDY:	IRQ GPIO
- akm8963,layout:	physical orientation layout of sensor.
- akm8963,outbit:	set number of data bits reported by the sensor.
- SR_1v8-supply:        Low Power Mode (LPM) regulator supply
- SR_2v85-supply:       High Power Mode (HBP) regulator supply

Optional Properties:
- akm8963,gpio_RST:	RESET GPIO
- vdd-supply:	        regulator suppy to VDD

Example:

	ak8963@0c {
		compatible = "motorola_compass,akm8963";
		reg = <0xc>;
		interrupt-parent = <&msmgpio>;
		interrupts = <66 0x2>;
		vdd-supply = <&pm8226_l19>;
		SR_1v8-supply = <&pm8226_l22>;
		SR_2v85-supply = <&pm8226_l19>;
		akm8963,layout = <6>;
		akm8963,outbit = <1>;
		akm8963,gpio_DRDY = <&msmgpio 66 0>;
		akm8963,gpio_RST = <&msmgpio 62 0>;
	};
```
